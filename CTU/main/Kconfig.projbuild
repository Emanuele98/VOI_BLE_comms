## CTU/main/Kconfig.projbuild
```kconfig
menu "CTU Static Configuration"

    config SD_CARD
        bool "Enable SD CARD"
        default y
    config WIFI
        bool "Enable WIFI"
        default y
    config WIFI_SSID
        string "WiFi name"
        default "RUT951_9456"
    config WIFI_PASSWORD
        string "WiFi password"
        default "cherrycookies"
    config BROKER_URI
        string "Broker URL"
        default "mqtts://bumblebee:Inductive1356@9f1c91ca48b94e70b21ae04163990bef.s1.eu.hivemq.cloud"
endmenu
```
